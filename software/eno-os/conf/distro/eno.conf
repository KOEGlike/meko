## software/eno-os/conf/layer.conf
```bitbake
BBPATH .= ":${LAYERDIR}"

BBFILES += "${LAYERDIR}/recipes-*/*/*.bb \
            ${LAYERDIR}/recipes-*/*/*.bbappend"

BBFILE_COLLECTIONS += "eno-os"
BBFILE_PATTERN_eno-os = "^${LAYERDIR}/"
BBFILE_PRIORITY_eno-os = "10"

LAYERDEPENDS_eno-os = "core"
LAYERSERIES_COMPAT_eno-os = "blacksail"
```
